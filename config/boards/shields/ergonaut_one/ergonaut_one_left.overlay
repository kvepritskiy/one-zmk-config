/*
 * SPDX-License-Identifier: MIT
 */

#include <dt-bindings/zmk/matrix_transform.h>

/ {
    chosen {
        zmk,kscan = &kscan0;
        zmk,matrix_transform = &default_transform;
    };

    default_transform: keymap_transform0 {
        compatible = "zmk,matrix-transform";
        columns = <6>;
        rows = <4>;
        map = <
            0 1 2 3 4 5
            6 7 8 9 10 11
            12 13 14 15 16 17
            65535 19 20 21 65535 65535
        >;
    };

    kscan0: kscan {
        compatible = "zmk,kscan-gpio-matrix";
        label = "KSCAN0";
        diode-direction = "row2col";
        
        row-gpios
            = <&gpio0 1 0>
            , <&gpio0 2 0>
            , <&gpio0 3 0>
            , <&gpio0 4 0>;
            
        col-gpios
            = <&gpio0 5 0>
            , <&gpio0 6 0>
            , <&gpio0 7 0>
            , <&gpio1 0 0>
            , <&gpio1 1 0>
            , <&gpio1 2 0>;
    };
};
